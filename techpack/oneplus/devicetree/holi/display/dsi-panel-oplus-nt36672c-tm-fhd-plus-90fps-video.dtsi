/* Copyright (c) 2019, The Linux Foundation. All rights reserved.
 *
 * This program is free software; you can redistribute it and/or modify
 * it under the terms of the GNU General Public License version 2 and
 * only version 2 as published by the Free Software Foundation.
 *
 * This program is distributed in the hope that it will be useful,
 * but WITHOUT ANY WARRANTY; without even the implied warranty of
 * MERCHANTABILITY or FITNESS FOR A PARTICULAR PURPOSE.  See the
 * GNU General Public License for more details.
 */

&mdss_mdp {
	dsi_nt36672c_tm_video: qcom,mdss_dsi_nt36672c_tm_video {
		qcom,mdss-dsi-panel-name =
			"nt36672c tm fhd plus video mode dsi panel";
		qcom,mdss-dsi-panel-type = "dsi_video_mode";
		qcom,dsi-ctrl-num = <0>;
		qcom,dsi-phy-num = <0>;
		qcom,mdss-dsi-virtual-channel-id = <0>;
		qcom,mdss-dsi-stream = <0>;
		qcom,mdss-dsi-h-left-border = <0>;
		qcom,mdss-dsi-h-right-border = <0>;
		qcom,mdss-dsi-v-top-border = <0>;
		qcom,mdss-dsi-v-bottom-border = <0>;
		qcom,mdss-dsi-bpp = <24>;
		qcom,mdss-dsi-color-order = "rgb_swap_rgb";
		qcom,mdss-dsi-underflow-color = <0xff>;
		qcom,mdss-dsi-border-color = <0>;
		qcom,mdss-dsi-h-sync-pulse = <0>;
		qcom,mdss-dsi-traffic-mode = "non_burst_sync_event";
		qcom,mdss-dsi-lane-map = "lane_map_0123";
		qcom,mdss-dsi-bllp-eof-power-mode;
		qcom,mdss-dsi-bllp-power-mode;
		qcom,ulps-enabled;
		qcom,suspend-ulps-enabled;
		qcom,mdss-dsi-tx-eot-append;
		qcom,mdss-dsi-lane-0-state;
		qcom,mdss-dsi-lane-1-state;
		qcom,mdss-dsi-lane-2-state;
		qcom,mdss-dsi-lane-3-state;
		qcom,mdss-dsi-dma-trigger = "trigger_sw";
		qcom,mdss-dsi-mdp-trigger = "none";
		qcom,mdss-dsi-reset-sequence = <1 20>, <0 20>, <1 20>;
		qcom,mdss-pan-physical-width-dimension = <68>;
		qcom,mdss-pan-physical-height-dimension = <152>;
		qcom,mdss-dsi-lp11-init;
		qcom,mdss-dsi-bl-min-level = <1>;
		qcom,mdss-dsi-bl-normal-max-level = <3383>;
		qcom,mdss-dsi-bl-max-level = <3570>;
		qcom,mdss-brightness-normal-max-level = <3383>;
		qcom,mdss-brightness-max-level = <3570>;
		qcom,mdss-brightness-default-level = <400>;
		qcom,mdss-dsi-video-mode;
		qcom,mdss-dsi-panel-peak-brightness = <4200000>;
		qcom,mdss-dsi-panel-blackness-level = <3230>;

		qcom,mdss-dsi-display-timings {
			timing@0{
				qcom,mdss-dsi-panel-width = <1080>;
				qcom,mdss-dsi-panel-height = <2400>;
				qcom,mdss-dsi-h-front-porch = <424>;
				qcom,mdss-dsi-h-back-porch = <22>;
				qcom,mdss-dsi-h-pulse-width = <22>;
				qcom,mdss-dsi-h-sync-skew = <0>;
				qcom,mdss-dsi-v-back-porch = <10>;
				qcom,mdss-dsi-v-front-porch = <54>;
				qcom,mdss-dsi-v-pulse-width = <10>;
				qcom,mdss-dsi-panel-framerate = <90>;

				qcom,mdss-dsi-on-command = [
						29 01 00 00 00 00 02 FF 20
						29 01 00 00 00 00 02 FB 01
						29 01 00 00 00 00 02 17 55
						29 01 00 00 00 00 02 1B 01
						29 01 00 00 00 00 02 2F 83
						29 01 00 00 00 00 02 5C 90
						29 01 00 00 00 00 02 5E AA
						29 01 00 00 00 00 02 69 D0
						29 01 00 00 00 00 02 F2 65
						29 01 00 00 00 00 02 F3 44
						29 01 00 00 00 00 02 F4 65
						29 01 00 00 00 00 02 F5 44
						29 01 00 00 00 00 02 F6 65
						29 01 00 00 00 00 02 F7 44
						29 01 00 00 00 00 02 F8 65
						29 01 00 00 00 00 02 F9 44

						29 01 00 00 00 00 02 FF 24
						29 01 00 00 00 00 02 FB 01
						29 01 00 00 00 00 02 34 03
						29 01 00 00 00 00 02 36 4E
						29 01 00 00 00 00 02 4D 03
						29 01 00 00 00 00 02 4E 44
						29 01 00 00 00 00 02 4F 44
						29 01 00 00 00 00 02 53 44
						29 01 00 00 00 00 02 7A 83
						29 01 00 00 00 00 02 7B 93
						29 01 00 00 00 00 02 7D 05
						29 01 00 00 00 00 02 80 05
						29 01 00 00 00 00 02 81 05
						29 01 00 00 00 00 02 A0 13
						29 01 00 00 00 00 02 A2 13
						29 01 00 00 00 00 02 A3 03
						29 01 00 00 00 00 02 A4 05
						29 01 00 00 00 00 02 A5 05
						29 01 00 00 00 00 02 E9 03

						29 01 00 00 00 00 02 FF 25
						29 01 00 00 00 00 02 FB 01
						29 01 00 00 00 00 02 0F 1B
						29 01 00 00 00 00 02 18 20
						29 01 00 00 00 00 02 79 81
						29 01 00 00 00 00 02 DA 02
						29 01 00 00 00 00 02 E0 02

						29 01 00 00 00 00 02 FF 26
						29 01 00 00 00 00 02 FB 01
						29 01 00 00 00 00 02 01 EB
						29 01 00 00 00 00 02 04 EB
						29 01 00 00 00 00 02 06 14
						29 01 00 00 00 00 02 08 14
						29 01 00 00 00 00 02 81 15
						29 01 00 00 00 00 02 88 02

						29 01 00 00 00 00 02 FF 27
						29 01 00 00 00 00 02 FB 01
						29 01 00 00 00 00 02 21 E7
						29 01 00 00 00 00 02 25 82
						29 01 00 00 00 00 02 26 1F
						29 01 00 00 00 00 02 E3 02
						29 01 00 00 00 00 02 E4 DA
						29 01 00 00 00 00 02 E9 03
						29 01 00 00 00 00 02 EA 2F

						29 01 00 00 00 00 02 FF 2A
						29 01 00 00 00 00 02 FB 01
						29 01 00 00 00 00 02 0C 09
						29 01 00 00 00 00 02 0F 00
						29 01 00 00 00 00 02 11 F0
						29 01 00 00 00 00 02 15 0E
						29 01 00 00 00 00 02 16 B6
						29 01 00 00 00 00 02 19 0E
						29 01 00 00 00 00 02 1A 8A
						29 01 00 00 00 00 02 1D 36
						29 01 00 00 00 00 02 1E 4F
						29 01 00 00 00 00 02 1F 4F
						29 01 00 00 00 00 02 20 4F
						29 01 00 00 00 00 02 28 EC
						29 01 00 00 00 00 02 29 0C
						29 01 00 00 00 00 02 2A 05
						29 01 00 00 00 00 02 2B 00
						29 01 00 00 00 00 02 2D 06
						29 01 00 00 00 00 02 2F 02
						29 01 00 00 00 00 02 30 4A
						29 01 00 00 00 00 02 31 3C
						29 01 00 00 00 00 02 33 0E
						29 01 00 00 00 00 02 34 EE
						29 01 00 00 00 00 02 35 30
						29 01 00 00 00 00 02 36 06
						29 01 00 00 00 00 02 37 E9
						29 01 00 00 00 00 02 38 34
						29 01 00 00 00 00 02 39 02
						29 01 00 00 00 00 02 3A 4A
						29 01 00 00 00 00 02 45 0E
						29 01 00 00 00 00 02 47 03
						29 01 00 00 00 00 02 4A A0
						29 01 00 00 00 00 02 4E 0E
						29 01 00 00 00 00 02 4F B6
						29 01 00 00 00 00 02 52 0E
						29 01 00 00 00 00 02 53 8A
						29 01 00 00 00 00 02 57 76
						29 01 00 00 00 00 02 58 76
						29 01 00 00 00 00 02 59 76

						29 01 00 00 00 00 02 FF 2C
						29 01 00 00 00 00 02 FB 01
						29 01 00 00 00 00 02 03 1F
						29 01 00 00 00 00 02 04 1F
						29 01 00 00 00 00 02 05 1F
						29 01 00 00 00 00 02 0E 75
						29 01 00 00 00 00 02 17 6B
						29 01 00 00 00 00 02 18 6B
						29 01 00 00 00 00 02 19 6B
						29 01 00 00 00 00 02 30 EB
						29 01 00 00 00 00 02 33 EB
						29 01 00 00 00 00 02 35 1E
						29 01 00 00 00 00 02 37 1E
						29 01 00 00 00 00 02 4D 21
						29 01 00 00 00 00 02 4F 05

						29 01 00 00 00 00 02 FF E0
						29 01 00 00 00 00 02 FB 01
						29 01 00 00 00 00 02 85 32
						29 01 00 00 00 00 02 35 82

						29 01 00 00 00 00 02 FF F0
						29 01 00 00 00 00 02 FB 01
						29 01 00 00 00 00 02 1C 01
						29 01 00 00 00 00 02 33 01
						29 01 00 00 00 00 02 5A 00

						29 01 00 00 00 00 02 FF 2B
						29 01 00 00 00 00 02 FB 01
						29 01 00 00 00 00 02 B7 09
						29 01 00 00 00 00 02 B8 04
						29 01 00 00 00 00 02 C0 02

						//add for cabc
						29 01 00 00 00 00 02 FF 23
						29 01 00 00 00 00 02 FB 01
						29 01 00 00 00 00 02 00 80
						29 01 00 00 00 00 02 05 22
						29 01 00 00 00 00 02 06 01
						29 01 00 00 00 00 02 07 00
						29 01 00 00 00 00 02 08 01
						29 01 00 00 00 00 02 09 00
						29 01 00 00 00 00 02 10 82
						29 01 00 00 00 00 02 11 01
						29 01 00 00 00 00 02 12 95
						29 01 00 00 00 00 02 15 68
						29 01 00 00 00 00 02 16 0B
						//CABC_PWM_UI
						29 01 00 00 00 00 02 30 FF
						29 01 00 00 00 00 02 31 FD
						29 01 00 00 00 00 02 32 FA
						29 01 00 00 00 00 02 33 F7
						29 01 00 00 00 00 02 34 F4
						29 01 00 00 00 00 02 35 F0
						29 01 00 00 00 00 02 36 ED
						29 01 00 00 00 00 02 37 EC
						29 01 00 00 00 00 02 38 EB
						29 01 00 00 00 00 02 39 EA
						29 01 00 00 00 00 02 3A E9
						29 01 00 00 00 00 02 3B E8
						29 01 00 00 00 00 02 3D E7
						29 01 00 00 00 00 02 3F E6
						29 01 00 00 00 00 02 40 E5
						29 01 00 00 00 00 02 41 E4
						//CABC_PWM_STILL
						29 01 00 00 00 00 02 45 FF
						29 01 00 00 00 00 02 46 FA
						29 01 00 00 00 00 02 47 F2
						29 01 00 00 00 00 02 48 E8
						29 01 00 00 00 00 02 49 E4
						29 01 00 00 00 00 02 4A DC
						29 01 00 00 00 00 02 4B D7
						29 01 00 00 00 00 02 4C D5
						29 01 00 00 00 00 02 4D D3
						29 01 00 00 00 00 02 4E D2
						29 01 00 00 00 00 02 4F D0
						29 01 00 00 00 00 02 50 CE
						29 01 00 00 00 00 02 51 CD
						29 01 00 00 00 00 02 52 CB
						29 01 00 00 00 00 02 53 C6
						29 01 00 00 00 00 02 54 C3

						29 01 00 00 00 00 02 FF 10
						29 01 00 00 00 00 02 FB 01
						39 01 00 00 00 00 06 3B 03 14 36 04 04
						29 01 00 00 00 00 02 B0 00
						29 01 00 00 00 00 02 C0 03
						39 01 00 00 00 00 11 C1 89 38 00 08 02 00 02 0E 00 BB 00 07 0D B7 0C B7
						39 01 00 00 00 00 03 C2 10 F0
						39 01 00 00 00 00 03 51 0F FF
						29 01 00 00 00 00 02 53 2C
						29 01 00 00 00 00 02 55 01
						29 01 00 00 00 00 02 35 00
						05 01 00 00 78 00 02 11 00
						05 01 00 00 14 00 02 29 00
					];

				qcom,mdss-dsi-off-command =[
					05 01 00 00 14 00 02 28 00
					05 01 00 00 78 00 02 10 00
					];

				qcom,mdss-dsi-cabc-1-command = [
					29 00 00 00 00 00 02 FF 10
					29 00 00 00 00 00 02 FB 01
					29 01 00 00 00 00 02 55 01
				];
				qcom,mdss-dsi-cabc-2-command = [
					29 00 00 00 00 00 02 FF 10
					29 00 00 00 00 00 02 FB 01
					29 01 00 00 00 00 02 55 02
				];
				qcom,mdss-dsi-cabc-3-command = [
					29 00 00 00 00 00 02 FF 10
					29 00 00 00 00 00 02 FB 01
					29 01 00 00 00 00 02 55 02
				];
				qcom,mdss-dsi-cabc-off-command = [
					29 00 00 00 00 00 02 FF 10
					29 00 00 00 00 00 02 FB 01
					29 01 00 00 00 00 02 55 00
				];

				qcom,mdss-dsi-on-command-state = "dsi_lp_mode";
				qcom,mdss-dsi-off-command-state = "dsi_lp_mode";
				qcom,mdss-dsi-cabc-1-command-state = "dsi_lp_mode";
				qcom,mdss-dsi-cabc-2-command-state = "dsi_lp_mode";
				qcom,mdss-dsi-cabc-3-command-state = "dsi_lp_mode";
				qcom,mdss-dsi-cabc-off-command-state = "dsi_lp_mode";

				qcom,compression-mode = "dsc";
				qcom,mdss-dsc-slice-height = <8>;
				qcom,mdss-dsc-slice-width = <540>;
				qcom,mdss-dsc-slice-per-pkt = <1>;
				qcom,mdss-dsc-bit-per-component = <8>;
				qcom,mdss-dsc-bit-per-pixel = <8>;
				qcom,mdss-dsc-block-prediction-enable;
			};
		};
	};
};

&dsi_nt36672c_tm_video {
	qcom,panel-supply-entries = <&dsi_panel_pwr_supply_labibb>;
	qcom,mdss-dsi-bl-pmic-control-type = "bl_ctrl_wled";
	qcom,platform-te-gpio = <&tlmm 23 0>;
	qcom,platform-reset-gpio = <&pm6150l_gpios 9 0>;
	qcom,esd-check-enabled;
	qcom,mdss-dsi-panel-status-check-mode = "reg_read";
	qcom,mdss-dsi-panel-status-command = [06 01 00 01 00 00 01 0a];
	qcom,mdss-dsi-panel-status-command-state = "dsi_hs_mode";
	qcom,mdss-dsi-panel-status-value = <0x9c>;
	qcom,mdss-dsi-panel-status-read-length = <1>;
	qcom,dsi-supported-dfps-list = <90 60>;
	qcom,mdss-dsi-pan-enable-dynamic-fps;
	qcom,mdss-dsi-pan-fps-update =
		"dfps_immediate_porch_mode_vfp";
	qcom,mdss-dsi-min-refresh-rate = <60>;
	qcom,mdss-dsi-max-refresh-rate = <90>;

	qcom,dsi-select-clocks = "mux_byte_clk0", "mux_pixel_clk0";
	qcom,mdss-dsi-t-clk-post = <0x0F>;
	qcom,mdss-dsi-t-clk-pre = <0x3A>;
	qcom,mdss-dsi-display-timings {
		timing@0 {
			qcom,mdss-dsi-panel-phy-timings = [00 24 0A 0A 26 24 0A 0A
										09 02 04 00];
			qcom,display-topology = <1 1 1>;
			qcom,default-topology-index = <0>;
		};
	};
};
