/* Copyright (c) 2019, The Linux Foundation. All rights reserved.
 *
 * This program is free software; you can redistribute it and/or modify
 * it under the terms of the GNU General Public License version 2 and
 * only version 2 as published by the Free Software Foundation.
 *
 * This program is distributed in the hope that it will be useful,
 * but WITHOUT ANY WARRANTY; without even the implied warranty of
 * MERCHANTABILITY or FITNESS FOR A PARTICULAR PURPOSE.  See the
 * GNU General Public License for more details.
 */

&mdss_mdp {
	dsi_nt36672c_dsjm_video: qcom,mdss_dsi_nt36672c_dsjm_video {
		qcom,mdss-dsi-panel-name =
			"nt36672c dsjm fhd plus video mode dsi panel";
		qcom,mdss-dsi-panel-type = "dsi_video_mode";
		qcom,dsi-ctrl-num = <0>;
		qcom,dsi-phy-num = <0>;
		qcom,mdss-dsi-virtual-channel-id = <0>;
		qcom,mdss-dsi-stream = <0>;
		qcom,mdss-dsi-h-left-border = <0>;
		qcom,mdss-dsi-h-right-border = <0>;
		qcom,mdss-dsi-v-top-border = <0>;
		qcom,mdss-dsi-v-bottom-border = <0>;
		qcom,mdss-dsi-bpp = <24>;
		qcom,mdss-dsi-color-order = "rgb_swap_rgb";
		qcom,mdss-dsi-underflow-color = <0xff>;
		qcom,mdss-dsi-border-color = <0>;
		qcom,mdss-dsi-h-sync-pulse = <0>;
		qcom,mdss-dsi-traffic-mode = "non_burst_sync_event";
		qcom,mdss-dsi-lane-map = "lane_map_0123";
		qcom,mdss-dsi-bllp-eof-power-mode;
		qcom,mdss-dsi-bllp-power-mode;
		qcom,ulps-enabled;
		qcom,suspend-ulps-enabled;
		qcom,mdss-dsi-tx-eot-append;
		qcom,mdss-dsi-lane-0-state;
		qcom,mdss-dsi-lane-1-state;
		qcom,mdss-dsi-lane-2-state;
		qcom,mdss-dsi-lane-3-state;
		qcom,mdss-dsi-dma-trigger = "trigger_sw";
		qcom,mdss-dsi-mdp-trigger = "none";
		qcom,mdss-dsi-reset-sequence = <1 20>, <0 20>, <1 20>;
		qcom,mdss-pan-physical-width-dimension = <68>;
		qcom,mdss-pan-physical-height-dimension = <152>;
		qcom,mdss-dsi-lp11-init;
		qcom,mdss-dsi-bl-min-level = <1>;
		qcom,mdss-dsi-bl-normal-max-level = <3383>;
		qcom,mdss-dsi-bl-max-level = <4095>;
		qcom,mdss-brightness-normal-max-level = <3383>;
		qcom,mdss-brightness-max-level = <4095>;
		qcom,mdss-brightness-default-level = <400>;
		qcom,mdss-dsi-video-mode;
		oppo,mdss-dsi-vendor-name = "NT36672C-90HZ";
		oppo,mdss-dsi-manufacture = "DSJM";

		qcom,mdss-dsi-panel-peak-brightness = <4200000>;
		qcom,mdss-dsi-panel-blackness-level = <3230>;

		qcom,mdss-dsi-display-timings {
			timing@0{
				qcom,mdss-dsi-panel-width = <1080>;
				qcom,mdss-dsi-panel-height = <2400>;
				qcom,mdss-dsi-h-front-porch = <424>;
				qcom,mdss-dsi-h-back-porch = <22>;
				qcom,mdss-dsi-h-pulse-width = <22>;
				qcom,mdss-dsi-h-sync-skew = <0>;
				qcom,mdss-dsi-v-back-porch = <10>;
				qcom,mdss-dsi-v-front-porch = <54>;
				qcom,mdss-dsi-v-pulse-width = <10>;
				qcom,mdss-dsi-panel-framerate = <90>;

				qcom,mdss-dsi-on-command = [
						29 01 00 00 00 00 02 FF 20
						29 01 00 00 00 00 02 FB 01
						29 01 00 00 00 00 02 01 66
						29 01 00 00 00 00 02 06 40
						29 01 00 00 00 00 02 07 38
						29 01 00 00 00 00 02 18 77
						29 01 00 00 00 00 02 1B 01
						29 01 00 00 00 00 02 69 91
						29 01 00 00 00 00 02 95 D1
						29 01 00 00 00 00 02 96 D1
						29 01 00 00 00 00 02 F2 65
						29 01 00 00 00 00 02 F3 74
						29 01 00 00 00 00 02 F4 65
						29 01 00 00 00 00 02 F5 74
						29 01 00 00 00 00 02 F6 65
						29 01 00 00 00 00 02 F7 74
						29 01 00 00 00 00 02 F8 65
						29 01 00 00 00 00 02 F9 74
						29 01 00 00 00 00 02 FF 24
						29 01 00 00 00 00 02 FB 01
						29 01 00 00 00 00 02 01 0F
						29 01 00 00 00 00 02 03 0C
						29 01 00 00 00 00 02 05 1D
						29 01 00 00 00 00 02 08 2F
						29 01 00 00 00 00 02 09 2E
						29 01 00 00 00 00 02 0A 2D
						29 01 00 00 00 00 02 0B 2C
						29 01 00 00 00 00 02 11 17
						29 01 00 00 00 00 02 12 13
						29 01 00 00 00 00 02 13 15
						29 01 00 00 00 00 02 15 14
						29 01 00 00 00 00 02 16 16
						29 01 00 00 00 00 02 17 18
						29 01 00 00 00 00 02 1B 01
						29 01 00 00 00 00 02 1D 1D
						29 01 00 00 00 00 02 20 2F
						29 01 00 00 00 00 02 21 2E
						29 01 00 00 00 00 02 22 2D
						29 01 00 00 00 00 02 23 2C
						29 01 00 00 00 00 02 29 17
						29 01 00 00 00 00 02 2A 13
						29 01 00 00 00 00 02 2B 15
						29 01 00 00 00 00 02 2F 14
						29 01 00 00 00 00 02 30 16
						29 01 00 00 00 00 02 31 18
						29 01 00 00 00 00 02 32 04
						29 01 00 00 00 00 02 34 10
						29 01 00 00 00 00 02 35 1F
						29 01 00 00 00 00 02 36 1F
						29 01 00 00 00 00 02 37 20
						29 01 00 00 00 00 02 4D 1B
						29 01 00 00 00 00 02 4E 4B
						29 01 00 00 00 00 02 4F 4B
						29 01 00 00 00 00 02 53 4B
						29 01 00 00 00 00 02 71 30
						29 01 00 00 00 00 02 79 11
						29 01 00 00 00 00 02 7A 82
						29 01 00 00 00 00 02 7B 96
						29 01 00 00 00 00 02 7D 04
						29 01 00 00 00 00 02 80 04
						29 01 00 00 00 00 02 81 04
						29 01 00 00 00 00 02 82 13
						29 01 00 00 00 00 02 84 31
						29 01 00 00 00 00 02 85 00
						29 01 00 00 00 00 02 86 00
						29 01 00 00 00 00 02 87 00
						29 01 00 00 00 00 02 90 13
						29 01 00 00 00 00 02 92 31
						29 01 00 00 00 00 02 93 00
						29 01 00 00 00 00 02 94 00
						29 01 00 00 00 00 02 95 00
						29 01 00 00 00 00 02 9C F4
						29 01 00 00 00 00 02 9D 01
						29 01 00 00 00 00 02 A0 16
						29 01 00 00 00 00 02 A2 16
						29 01 00 00 00 00 02 A3 02
						29 01 00 00 00 00 02 A4 04
						29 01 00 00 00 00 02 A5 04
						29 01 00 00 00 00 02 C6 C0
						29 01 00 00 00 00 02 C9 00
						29 01 00 00 00 00 02 D9 80
						29 01 00 00 00 00 02 E9 02
						29 01 00 00 00 00 02 FF 25
						29 01 00 00 00 00 02 FB 01
						29 01 00 00 00 00 02 18 20
						29 01 00 00 00 00 02 19 E4
						29 01 00 00 00 00 02 21 40
						29 01 00 00 00 00 02 66 D8
						29 01 00 00 00 00 02 68 50
						29 01 00 00 00 00 02 69 10
						29 01 00 00 00 00 02 6B 00
						29 01 00 00 00 00 02 6D 0D
						29 01 00 00 00 00 02 6E 48
						29 01 00 00 00 00 02 72 41
						29 01 00 00 00 00 02 73 4A
						29 01 00 00 00 00 02 74 D0
						29 01 00 00 00 00 02 77 62
						29 01 00 00 00 00 02 79 7F
						29 01 00 00 00 00 02 7D 03
						29 01 00 00 00 00 02 7E 15
						29 01 00 00 00 00 02 7F 00
						29 01 00 00 00 00 02 84 4D
						29 01 00 00 00 00 02 CF 80
						29 01 00 00 00 00 02 D6 80
						29 01 00 00 00 00 02 D7 80
						29 01 00 00 00 00 02 EF 20
						29 01 00 00 00 00 02 F0 84
						29 01 00 00 00 00 02 FF 26
						29 01 00 00 00 00 02 FB 01
						29 01 00 00 00 00 02 80 05
						29 01 00 00 00 00 02 81 16
						29 01 00 00 00 00 02 83 03
						29 01 00 00 00 00 02 84 03
						29 01 00 00 00 00 02 85 01
						29 01 00 00 00 00 02 86 03
						29 01 00 00 00 00 02 87 01
						29 01 00 00 00 00 02 88 04
						29 01 00 00 00 00 02 8A 1A
						29 01 00 00 00 00 02 8B 11
						29 01 00 00 00 00 02 8C 24
						29 01 00 00 00 00 02 8E 42
						29 01 00 00 00 00 02 8F 11
						29 01 00 00 00 00 02 90 11
						29 01 00 00 00 00 02 91 11
						29 01 00 00 00 00 02 9A 81
						29 01 00 00 00 00 02 9B 03
						29 01 00 00 00 00 02 9C 00
						29 01 00 00 00 00 02 9D 00
						29 01 00 00 00 00 02 9E 00
						29 01 00 00 00 00 02 FF 27
						29 01 00 00 00 00 02 FB 01
						29 01 00 00 00 00 02 01 60
						29 01 00 00 00 00 02 20 81
						29 01 00 00 00 00 02 21 EA
						29 01 00 00 00 00 02 25 82
						29 01 00 00 00 00 02 26 1F
						29 01 00 00 00 00 02 6E 00
						29 01 00 00 00 00 02 6F 00
						29 01 00 00 00 00 02 70 00
						29 01 00 00 00 00 02 71 00
						29 01 00 00 00 00 02 72 00
						29 01 00 00 00 00 02 75 00
						29 01 00 00 00 00 02 76 00
						29 01 00 00 00 00 02 77 00
						29 01 00 00 00 00 02 7D 09
						29 01 00 00 00 00 02 7E 5F
						29 01 00 00 00 00 02 80 23
						29 01 00 00 00 00 02 82 09
						29 01 00 00 00 00 02 83 5F
						29 01 00 00 00 00 02 88 01
						29 01 00 00 00 00 02 89 10
						29 01 00 00 00 00 02 A5 10
						29 01 00 00 00 00 02 A6 23
						29 01 00 00 00 00 02 A7 01
						29 01 00 00 00 00 02 B6 40
						29 01 00 00 00 00 02 E3 02
						29 01 00 00 00 00 02 E4 E0
						29 01 00 00 00 00 02 E5 01
						29 01 00 00 00 00 02 E6 70
						29 01 00 00 00 00 02 E9 03
						29 01 00 00 00 00 02 EA 2F
						29 01 00 00 00 00 02 EB 01
						29 01 00 00 00 00 02 EC 98
						29 01 00 00 00 00 02 FF 2A
						29 01 00 00 00 00 02 FB 01
						29 01 00 00 00 00 02 00 91
						29 01 00 00 00 00 02 03 20
						29 01 00 00 00 00 02 07 52
						29 01 00 00 00 00 02 0A 70
						29 01 00 00 00 00 02 0C 06
						29 01 00 00 00 00 02 0D 40
						29 01 00 00 00 00 02 0E 02
						29 01 00 00 00 00 02 0F 01
						29 01 00 00 00 00 02 11 58
						29 01 00 00 00 00 02 15 0F
						29 01 00 00 00 00 02 16 96
						29 01 00 00 00 00 02 19 0F
						29 01 00 00 00 00 02 1A 6A
						29 01 00 00 00 00 02 1B 14
						29 01 00 00 00 00 02 1D 36
						29 01 00 00 00 00 02 1E 54
						29 01 00 00 00 00 02 1F 54
						29 01 00 00 00 00 02 20 54
						29 01 00 00 00 00 02 28 FD
						29 01 00 00 00 00 02 29 0B
						29 01 00 00 00 00 02 2A 60
						29 01 00 00 00 00 02 2B 03
						29 01 00 00 00 00 02 2D 08
						29 01 00 00 00 00 02 2F 01
						29 01 00 00 00 00 02 30 47
						29 01 00 00 00 00 02 31 48
						29 01 00 00 00 00 02 33 34
						29 01 00 00 00 00 02 34 FF
						29 01 00 00 00 00 02 35 2F
						29 01 00 00 00 00 02 36 75
						29 01 00 00 00 00 02 37 FA
						29 01 00 00 00 00 02 38 33
						29 01 00 00 00 00 02 39 71
						29 01 00 00 00 00 02 3A 47
						29 01 00 00 00 00 02 46 40
						29 01 00 00 00 00 02 47 02
						29 01 00 00 00 00 02 4A F0
						29 01 00 00 00 00 02 4E 0F
						29 01 00 00 00 00 02 4F 96
						29 01 00 00 00 00 02 52 0F
						29 01 00 00 00 00 02 53 6A
						29 01 00 00 00 00 02 54 14
						29 01 00 00 00 00 02 56 36
						29 01 00 00 00 00 02 57 7E
						29 01 00 00 00 00 02 58 7E
						29 01 00 00 00 00 02 59 7E
						29 01 00 00 00 00 02 60 80
						29 01 00 00 00 00 02 61 C7
						29 01 00 00 00 00 02 62 03
						29 01 00 00 00 00 02 63 F3
						29 01 00 00 00 00 02 64 03
						29 01 00 00 00 00 02 65 05
						29 01 00 00 00 00 02 66 01
						29 01 00 00 00 00 02 67 04
						29 01 00 00 00 00 02 68 8A
						29 01 00 00 00 00 02 6A 0F
						29 01 00 00 00 00 02 6B C9
						29 01 00 00 00 00 02 6C 20
						29 01 00 00 00 00 02 6D E3
						29 01 00 00 00 00 02 6E C6
						29 01 00 00 00 00 02 6F 22
						29 01 00 00 00 00 02 70 E1
						29 01 00 00 00 00 02 71 04
						29 01 00 00 00 00 02 7A 07
						29 01 00 00 00 00 02 7B 40

						29 01 00 00 00 00 02 7D 01
						29 01 00 00 00 00 02 7F 2C
						29 01 00 00 00 00 02 83 0E
						29 01 00 00 00 00 02 84 8A
						29 01 00 00 00 00 02 87 0E
						29 01 00 00 00 00 02 88 5E
						29 01 00 00 00 00 02 89 14
						29 01 00 00 00 00 02 8B 36
						29 01 00 00 00 00 02 8C 3B
						29 01 00 00 00 00 02 8D 3B
						29 01 00 00 00 00 02 8E 3B
						29 01 00 00 00 00 02 95 80
						29 01 00 00 00 00 02 96 FD
						29 01 00 00 00 00 02 97 14
						29 01 00 00 00 00 02 98 02
						29 01 00 00 00 00 02 99 01
						29 01 00 00 00 00 02 9A 08
						29 01 00 00 00 00 02 9B 02
						29 01 00 00 00 00 02 9C 4C
						29 01 00 00 00 00 02 9D AD
						29 01 00 00 00 00 02 9F 61
						29 01 00 00 00 00 02 A0 FF
						29 01 00 00 00 00 02 A2 3F
						29 01 00 00 00 00 02 A3 6E
						29 01 00 00 00 00 02 A4 F9
						29 01 00 00 00 00 02 A5 44
						29 01 00 00 00 00 02 A6 69
						29 01 00 00 00 00 02 A7 4C
						29 01 00 00 00 00 02 FF 2C
						29 01 00 00 00 00 02 FB 01
						29 01 00 00 00 00 02 00 02
						29 01 00 00 00 00 02 01 02
						29 01 00 00 00 00 02 02 02
						29 01 00 00 00 00 02 03 16
						29 01 00 00 00 00 02 04 16
						29 01 00 00 00 00 02 05 16
						29 01 00 00 00 00 02 0D 1F
						29 01 00 00 00 00 02 0E 1F
						29 01 00 00 00 00 02 16 1B
						29 01 00 00 00 00 02 17 4B
						29 01 00 00 00 00 02 18 4B
						29 01 00 00 00 00 02 19 4B
						29 01 00 00 00 00 02 2A 03
						29 01 00 00 00 00 02 4D 16
						29 01 00 00 00 00 02 4E 03
						29 01 00 00 00 00 02 4F 2E
						29 01 00 00 00 00 02 53 02
						29 01 00 00 00 00 02 54 02
						29 01 00 00 00 00 02 55 02
						29 01 00 00 00 00 02 56 0E
						29 01 00 00 00 00 02 58 0E
						29 01 00 00 00 00 02 59 0E
						29 01 00 00 00 00 02 61 1F
						29 01 00 00 00 00 02 62 1F
						29 01 00 00 00 00 02 6A 14
						29 01 00 00 00 00 02 6B 34
						29 01 00 00 00 00 02 6C 34
						29 01 00 00 00 00 02 6D 34
						29 01 00 00 00 00 02 7E 03
						29 01 00 00 00 00 02 9D 0F
						29 01 00 00 00 00 02 9E 03
						29 01 00 00 00 00 02 9F 00
						29 01 00 00 00 00 02 FF 20
						29 01 00 00 00 00 02 FB 01
						29 01 00 00 00 00 02 FF 10
						29 01 00 00 00 00 02 FF F0
						29 01 00 00 00 00 02 FB 01
						29 01 00 00 00 00 02 5A 00
						29 01 00 00 00 00 02 FF 10
						29 01 00 00 00 00 02 FF 10
						29 01 00 00 00 00 02 FB 01
						29 01 00 00 00 00 02 B0 00
						29 01 00 00 00 00 02 C0 03
						39 01 00 00 00 00 11 C1 89 28 00 08 00 AA 02 0E 00 2B 00 07 0D B7 0C B7
						39 01 00 00 00 00 02 C2 1B A0
						39 01 00 00 00 00 02 51 0F FF
						29 01 00 00 00 00 02 53 2C
						29 01 00 00 00 00 02 55 00
						29 01 00 00 00 00 02 35 00
						05 01 00 00 78 00 02 11 00
						05 01 00 00 14 00 02 29 00
					];

				qcom,mdss-dsi-off-command =[
					05 01 00 00 14 00 02 28 00
					05 01 00 00 78 00 02 10 00
					];
				qcom,mdss-dsi-on-command-state = "dsi_lp_mode";
				qcom,mdss-dsi-off-command-state = "dsi_hs_mode";

				qcom,compression-mode = "dsc";
				qcom,mdss-dsc-slice-height = <8>;
				qcom,mdss-dsc-slice-width = <540>;
				qcom,mdss-dsc-slice-per-pkt = <1>;
				qcom,mdss-dsc-bit-per-component = <8>;
				qcom,mdss-dsc-bit-per-pixel = <8>;
				qcom,mdss-dsc-block-prediction-enable;
			};
		};
	};
};


&dsi_nt36672c_dsjm_video {
	qcom,panel-supply-entries = <&dsi_panel_pwr_supply_labibb>;
	qcom,mdss-dsi-bl-pmic-control-type = "bl_ctrl_wled";
	qcom,platform-te-gpio = <&tlmm 23 0>;
	qcom,platform-reset-gpio = <&pm6150l_gpios 9 0>;
	/*
	qcom,esd-check-enabled;
	qcom,mdss-dsi-panel-status-check-mode = "reg_read";
	qcom,mdss-dsi-panel-status-command = [06 01 00 01 00 00 01 0a];
	qcom,mdss-dsi-panel-status-command-state = "dsi_hs_mode";
	qcom,mdss-dsi-panel-status-value = <0x1c>;
	qcom,mdss-dsi-panel-status-read-length = <1>;
	*/
	qcom,dsi-supported-dfps-list = <90 60 45>;
	qcom,mdss-dsi-pan-enable-dynamic-fps;
	qcom,mdss-dsi-pan-fps-update =
		"dfps_immediate_porch_mode_vfp";
	qcom,mdss-dsi-min-refresh-rate = <45>;
	qcom,mdss-dsi-max-refresh-rate = <90>;
	oppo,dfps-idle-off;

	qcom,dsi-select-clocks = "mux_byte_clk0", "mux_pixel_clk0";
	qcom,mdss-dsi-t-clk-post = <0x0F>;
	qcom,mdss-dsi-t-clk-pre = <0x3A>;
	qcom,mdss-dsi-display-timings {
		timing@0 {
			qcom,mdss-dsi-panel-phy-timings = [00 24 0A 0A 26 24 0A 0A
										09 02 04 00];
			qcom,display-topology = <1 1 1>;
			qcom,default-topology-index = <0>;
		};
	};
};
