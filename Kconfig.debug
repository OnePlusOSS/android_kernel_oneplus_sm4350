## Kconfig.debug
```kconfig
# SPDX-License-Identifier: GPL-2.0-only
# This config refers to the generic oplus debug mode.

#ifdef CONFIG_OPLUS_SYSTEM_KERNEL
#config OPLUS_SYSTEM_KERNEL_QCOM
#  bool "config oplus system feature "
#  default y
#  help
#	define this config to Distinguish between qcom and mtk platform
#
#config OPLUS_SYSTEM_KERNEL_MTK
#  bool "config oplus system feature "
#  default n
#  help
#	define this config to Distinguish between qcom and mtk platform

config OPLUS_AGING_DEBUG
	bool "oplus aging add config"
	depends on QGKI
	select IPC_LOGGING
	select QCOM_RTB
	select QCOM_RTB_SEPARATE_CPUS
	select QCOM_RTB_QGKI
        select DEBUG_LIST
	#select MHI_DEBUG
	default y if "$(OPLUS_AGING_TEST)" = "true"
	default n

config OPLUS_KASAN_DEBUG
	bool "oplus kasan debug"
	depends on QGKI
	select KASAN
	select KASAN_GENERIC
	#select KCOV
	#select KCOV_ENABLE_COMPARISONS
	default y if "$(OPLUS_KASAN_TEST)" = "true"
	default n

config OPLUS_KMEMLEAK_DEBUG
	bool "oplus kmemleak debug"
	depends on QGKI
	select DEBUG_KMEMLEAK
	select SLUB_DEBUG
	#select SLABTRACE_DEBUG
	default y if "$(OPLUS_KMEMLEAK_TEST)" = "true"
	default n

config OPLUS_SLUB_DEBUG
	bool "oplus slub debug"
	select SLUB_DEBUG
	select SLUB_DEBUG_ON
	select SLUB_DEBUG_PANIC_ON
	default y if "$(OPLUS_SLUB_TEST)" = "true"
	default n

config OPLUS_PAGEOWNER_DEBUG
	bool "oplus pageowner debug"
	select PAGE_OWNER
	select PAGE_OWNER_ENABLE_DEFAULT
	default y if "$(OPLUS_PAGEOWNER_TEST)" = "true"
	default n
#endif /*CONFIG_OPLUS_SYSTEM_KERNEL*/
```

## drivers/nfc/oplus_nfc/Kconfig
```kconfig
config OPLUS_NFC
  tristate "config oplus nfc chipset"
  default m
  help
	define this config to get chipset version from dts.
```

## drivers/nfc/st21nfc/Kconfig
```kconfig
config NFC_ST21NFC
  tristate "ST Microelectronics ST21NFC NFC Controller Driver"
  default m
  ---help---
      ST Microelectronics ST21NFC Near Field Communication controller
```

## drivers/power/Kconfig
```kconfig
# SPDX-License-Identifier: GPL-2.0-only
source "drivers/power/avs/Kconfig"
source "drivers/power/reset/Kconfig"
source "drivers/power/supply/Kconfig"

#ifdef VENDOR_EDIT
config OPLUS_CHG
	tristate "OPLUS CHARGER KO module"
	default m
	help
	  Enables support for the oplus charging framework

config OPLUS_SM4350R_CHARGER
	bool "OPLUS SM4350 charger driver"
	default n
	help
	  Enables support for the oplus charging framework

config OPLUS_SHORT_C_BATT_CHECK
	bool "OPLUS_SHORT_C_BATT CHECK SUPPORT"
	default n
	help
	  Say Y to include support

config OPLUS_SMART_CHARGER_SUPPORT
	bool "OPLUS smart charger support"
	help
	  Say Y to include support

config OPLUS_SHORT_HW_CHECK
	bool "OPLUS_SHORT_HW CHECK SUPPORT"
	default n
	help
	  Say Y to include support

config OPLUS_CHIP_SOC_NODE
	bool "OPLUS chip soc node"
	help
	  Say Y to include support

config OPLUS_SHORT_IC_CHECK
	bool "OPLUS_SHORT_IC CHECK SUPPORT"
	default n
	help
	  Say Y to include support

config OPLUS_RTC_DET_SUPPORT
	bool "OPLUS RTC DET SUPPORT"
	default n
	help
	  Say Y to include support

config OPLUS_CHECK_CHARGERID_VOLT
	bool "OPLUS CHECK CHARGERID VOLT"
	default n
	help
	  Say Y to include support

config OPLUS_SHIP_MODE_SUPPORT
	bool "OPLUS_SHIP_MODE_SUPPORT"
	default n
	help
	  Say Y to include support

config OPLUS_SHORT_USERSPACE
	bool "OPLUS batt userspace"
	help
	  Say Y to include support

config OPLUS_BQ25601D_SLAVE_CHARGER
	tristate "BQ25600 Slave Battery Charger"
	depends on IIO
	help
	  Say Y to include support for BQ25600 Battery Charger.
	  The driver supports charger enable/disable.
	  The driver reports the charger status via the power supply framework.
	  A charger status change triggers an IRQ via the device STAT pin.

source "drivers/power/oplus/Kconfig"
source "drivers/power/oplus_util/Kconfig"
#endif
```

## drivers/power/oplus_util/Kconfig
```kconfig
config OPLUS_POWER_UTIL
	bool "oplus power util debug feature"
	depends on PM_SLEEP
	default n
	help
	    Oplus power debug feature
```

## drivers/soc/oplus/device_info/Kconfig
```kconfig
config OPLUS_DEVICE_IFNO
  tristate "config oplus devinfo software"
  ---help---
    say Y to enable define this config to compile devinfo.c for device register
    Say M to enable define this config to compile devinfo.c for device register as module.
```

## net/oplus_kernel2user/Kconfig
```kconfig
# SPDX-License-Identifier: GPL-2.0-only
# Copyright (C) 2020-2022 Oplus. All rights reserved.

config OPLUS_FEATURE_DATA_EVAL
        bool "Add for network score"
        help
          Add for Add for network score.
```

## techpack/oneplus/input/oplus_touchscreen/Novatek/Kconfig
```kconfig
#source "drivers/input/touchscreen/oplus_touchscreen/Novatek/NT36672/Kconfig"
#source "drivers/input/touchscreen/oplus_touchscreen/Novatek/NT36525/Kconfig"
#source "drivers/input/touchscreen/oplus_touchscreen/Novatek/NT36672_noflash/Kconfig"
#source "drivers/input/touchscreen/oplus_touchscreen/Novatek/NT36525_noflash/Kconfig"

source "techpack/oneplus/input/oplus_touchscreen/Novatek/NT36672C_noflash/Kconfig"
```

## techpack/oneplus/input/oplus_touchscreen/ilitek/Kconfig
```kconfig
source "techpack/oneplus/input/oplus_touchscreen/ilitek/ilitek9881h/Kconfig"
source "techpack/oneplus/input/oplus_touchscreen/ilitek/ilitek7807s/Kconfig"
```

## techpack/oneplus/input/oplus_touchscreen/ilitek/ilitek9881h/Kconfig
```kconfig
config TOUCHPANEL_ILITEK_ILITEK9881H_V3
#	default y
	tristate "TP ilitek ilitek9881h IC enable or not for OPLUS"
	---help---
	say Y to enable driver for Touchpanel using ilitek ilitek9881h
```
