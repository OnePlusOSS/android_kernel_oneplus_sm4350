/* Copyright (c) 2019, The Linux Foundation. All rights reserved.
 *
 * This program is free software; you can redistribute it and/or modify
 * it under the terms of the GNU General Public License version 2 and
 * only version 2 as published by the Free Software Foundation.
 *
 * This program is distributed in the hope that it will be useful,
 * but WITHOUT ANY WARRANTY; without even the implied warranty of
 * MERCHANTABILITY or FITNESS FOR A PARTICULAR PURPOSE.  See the
 * GNU General Public License for more details.
 */

&mdss_mdp {
	dsi_ili7807s_tm_video: qcom,mdss_dsi_ili7807s_tm_video {
		qcom,mdss-dsi-panel-name =
			"ili7807s tm fhd plus video mode dsi panel";
		qcom,mdss-dsi-panel-type = "dsi_video_mode";
		qcom,dsi-ctrl-num = <0>;
		qcom,dsi-phy-num = <0>;
		qcom,mdss-dsi-virtual-channel-id = <0>;
		qcom,mdss-dsi-stream = <0>;
		qcom,mdss-dsi-h-left-border = <0>;
		qcom,mdss-dsi-h-right-border = <0>;
		qcom,mdss-dsi-v-top-border = <0>;
		qcom,mdss-dsi-v-bottom-border = <0>;
		qcom,mdss-dsi-bpp = <24>;
		qcom,mdss-dsi-color-order = "rgb_swap_rgb";
		qcom,mdss-dsi-underflow-color = <0xff>;
		qcom,mdss-dsi-border-color = <0>;
		qcom,mdss-dsi-h-sync-pulse = <0>;
		qcom,mdss-dsi-traffic-mode = "non_burst_sync_event";
		qcom,mdss-dsi-lane-map = "lane_map_0123";
		qcom,mdss-dsi-bllp-eof-power-mode;
		qcom,mdss-dsi-bllp-power-mode;
		qcom,ulps-enabled;
		qcom,suspend-ulps-enabled;
		qcom,mdss-dsi-tx-eot-append;
		qcom,mdss-dsi-lane-0-state;
		qcom,mdss-dsi-lane-1-state;
		qcom,mdss-dsi-lane-2-state;
		qcom,mdss-dsi-lane-3-state;
		qcom,mdss-dsi-dma-trigger = "trigger_sw";
		qcom,mdss-dsi-mdp-trigger = "none";
		qcom,mdss-dsi-reset-sequence = <1 20>, <0 20>, <1 20>;
		qcom,mdss-pan-physical-width-dimension = <68>;
		qcom,mdss-pan-physical-height-dimension = <152>;
		qcom,mdss-dsi-lp11-init;
		qcom,mdss-dsi-bl-min-level = <1>;
		qcom,mdss-dsi-bl-normal-max-level = <3570>;
		qcom,mdss-dsi-bl-max-level = <4095>;
		qcom,mdss-brightness-normal-max-level = <3570>;
		qcom,mdss-brightness-max-level = <4095>;
		qcom,mdss-brightness-default-level = <400>;
		qcom,mdss-dsi-video-mode;
		oppo,mdss-dsi-vendor-name = "ILI7807S-90HZ";
		oppo,mdss-dsi-manufacture = "TIANMA";
		qcom,mdss-dsi-panel-hdr-enabled;
		qcom,mdss-dsi-panel-hdr-color-primaries = < 14500 15500 32000
			17000 15500 30000 8000 3000>;
		qcom,mdss-dsi-panel-peak-brightness = <4200000>;
		qcom,mdss-dsi-panel-blackness-level = <3230>;

		qcom,mdss-dsi-display-timings {
			timing@0{
				qcom,mdss-dsi-panel-clockrate = <1107000000>;
				qcom,mdss-dsi-panel-width = <1080>;
				qcom,mdss-dsi-panel-height = <2400>;
				qcom,mdss-dsi-h-front-porch = <220>;
				qcom,mdss-dsi-h-back-porch = <160>;
				qcom,mdss-dsi-h-pulse-width = <88>;
				qcom,mdss-dsi-h-sync-skew = <0>;
				qcom,mdss-dsi-v-back-porch = <10>;
				qcom,mdss-dsi-v-front-porch = <56>;
				qcom,mdss-dsi-v-pulse-width = <10>;
				qcom,mdss-dsi-panel-framerate = <90>;

				qcom,mdss-dsi-on-command = [
						29 01 00 00 00 00 04 FF 78 07 06
						29 01 00 00 00 00 02 08 20
						29 01 00 00 00 00 02 11 70
						29 01 00 00 00 00 02 10 0D
						29 01 00 00 00 00 02 48 0F
						29 01 00 00 00 00 02 4D 80
						29 01 00 00 00 00 02 4E 40
						29 01 00 00 00 00 02 C7 05
						29 01 00 00 00 00 04 FF 78 07 05
						29 01 00 00 00 00 02 7E 07
						29 01 00 00 00 00 04 FF 78 07 03
						29 01 00 00 00 00 02 83 20
						29 01 00 00 00 00 02 84 00
						29 01 00 00 00 00 04 FF 78 07 03
						29 01 00 00 00 00 02 86 47
						29 01 00 00 00 00 02 87 56
						29 01 00 00 00 00 02 AF 18
						29 01 00 00 00 00 02 8C E2
						29 01 00 00 00 00 02 8D E3
						29 01 00 00 00 00 02 8E E5
						29 01 00 00 00 00 02 8F E6
						29 01 00 00 00 00 02 90 E9
						29 01 00 00 00 00 02 91 EB
						29 01 00 00 00 00 02 92 EE
						29 01 00 00 00 00 02 93 F0
						29 01 00 00 00 00 02 94 F6
						29 01 00 00 00 00 02 95 FA
						29 01 00 00 00 00 02 96 BF
						29 01 00 00 00 00 02 97 C4
						29 01 00 00 00 00 02 98 C7
						29 01 00 00 00 00 02 99 C9
						29 01 00 00 00 00 02 9A CF
						29 01 00 00 00 00 02 9B D4
						29 01 00 00 00 00 02 9C DA
						29 01 00 00 00 00 02 9D E2
						29 01 00 00 00 00 02 9E EB
						29 01 00 00 00 00 02 9F FA
						29 01 00 00 00 00 04 FF 78 07 00
						29 01 00 00 00 00 03 51 0F FF
						29 01 00 00 00 00 02 53 24
						29 01 00 00 00 00 02 55 01
						29 01 00 00 00 00 02 35 00
						29 01 00 00 50 00 02 11 00
						29 01 00 00 00 00 04 FF 78 07 06
						29 01 00 00 00 00 02 96 10
						29 01 00 00 00 00 04 FF 78 07 00
						29 01 00 00 14 00 02 29 00
						29 01 00 00 00 00 04 FF 78 07 0F
					];

				qcom,mdss-dsi-off-command =[
						05 01 00 00 14 00 02 28 00
						05 01 00 00 78 00 02 10 00
					];
				qcom,mdss-dsi-cabc-1-command = [
						29 00 00 00 00 00 04 FF 78 07 00
						29 00 00 00 00 00 02 55 01
						29 01 00 00 00 00 04 FF 78 07 0F
				];
				qcom,mdss-dsi-cabc-2-command = [
						29 00 00 00 00 00 04 FF 78 07 00
						29 00 00 00 00 00 02 55 02
						29 01 00 00 00 00 04 FF 78 07 0F
				];
				qcom,mdss-dsi-cabc-3-command = [
						29 00 00 00 00 00 04 FF 78 07 00
						29 00 00 00 00 00 02 55 02
						29 01 00 00 00 00 04 FF 78 07 0F
				];
				qcom,mdss-dsi-cabc-off-command = [
						29 00 00 00 00 00 04 FF 78 07 00
						29 00 00 00 00 00 02 55 00
						29 01 00 00 00 00 04 FF 78 07 0F
				];
				qcom,mdss-dsi-on-command-state = "dsi_lp_mode";
				qcom,mdss-dsi-off-command-state = "dsi_lp_mode";
				qcom,mdss-dsi-cabc-1-command-state = "dsi_lp_mode";
				qcom,mdss-dsi-cabc-2-command-state = "dsi_lp_mode";
				qcom,mdss-dsi-cabc-3-command-state = "dsi_lp_mode";
				qcom,mdss-dsi-cabc-off-command-state = "dsi_lp_mode";

				qcom,compression-mode = "dsc";
				qcom,mdss-dsc-slice-height = <8>;
				qcom,mdss-dsc-slice-width = <540>;
				qcom,mdss-dsc-slice-per-pkt = <1>;
				qcom,mdss-dsc-bit-per-component = <8>;
				qcom,mdss-dsc-bit-per-pixel = <8>;
				qcom,mdss-dsc-block-prediction-enable;
			};
		};
	};
};

&dsi_ili7807s_tm_video {
	qcom,panel-supply-entries = <&dsi_panel_pwr_supply_labibb>;
	qcom,mdss-dsi-bl-pmic-control-type = "bl_ctrl_wled";
	qcom,platform-te-gpio = <&tlmm 23 0>;
	qcom,platform-reset-gpio = <&pm6150l_gpios 9 0>;
	/*
	qcom,esd-check-enabled;
	qcom,mdss-dsi-panel-status-check-mode = "reg_read";
	qcom,mdss-dsi-panel-status-command = [06 01 00 01 00 00 01 0a];
	qcom,mdss-dsi-panel-status-command-state = "dsi_hs_mode";
	qcom,mdss-dsi-panel-status-value = <0x1c>;
	qcom,mdss-dsi-panel-status-read-length = <1>;
	*/
	qcom,dsi-supported-dfps-list = <90 60 45>;
	qcom,mdss-dsi-pan-enable-dynamic-fps;
	qcom,mdss-dsi-pan-fps-update =
		"dfps_immediate_porch_mode_vfp";
	qcom,mdss-dsi-min-refresh-rate = <45>;
	qcom,mdss-dsi-max-refresh-rate = <90>;
	oppo,dfps-idle-off;

	qcom,dsi-select-clocks = "mux_byte_clk0", "mux_pixel_clk0";
	qcom,mdss-dsi-t-clk-post = <0x0F>;
	qcom,mdss-dsi-t-clk-pre = <0x3A>;
	qcom,mdss-dsi-display-timings {
		timing@0 {
			qcom,mdss-dsi-panel-phy-timings = [00 24 0A 0A 26 24 0A 0A
										09 02 04 00];
			qcom,display-topology = <1 1 1>;
			qcom,default-topology-index = <0>;
		};
	};
};
