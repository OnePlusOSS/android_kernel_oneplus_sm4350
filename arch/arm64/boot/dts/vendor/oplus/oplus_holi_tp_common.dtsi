#include "n200_tp_firmware.dtsi"
&qupv3_se0_spi {
	status = "ok";

	novatek@0 {
		status = "ok";
		compatible = "novatek,nf_nt36672c";
		reg = <0>;
		chip-num = <1>;
		chip-name = "NF_NT36672C";

		spi-max-frequency = <12000000>;	//4800000,9600000,15000000,19200000
		interrupt-parent = <&tlmm>;
		interrupts = <22 0x0>;
		irq-gpio = <&tlmm 22 0x2002>;
		reset-gpio = <&tlmm 21 0x00>;
		cs-gpio = <&tlmm 3 0x00>;

		touchpanel,max-num-support = <10>;
		touchpanel,tx-rx-num = <16 36>;
		touchpanel,panel-coords = <1080 2400>;
		touchpanel,display-coords = <1080 2400>;
		touchpanel,touchmajor-limit = <0 54>;

		panel_type = <7>; //7:tiam ma panel
		project_id = <20818>;
		platform_support_project = <20818>;
		platform_support_project_dir = <20818>;
		platform_support_project_commandline = "nt36672c_tm";

		pinctrl-names = "default", "suspend";
		pinctrl-0 = <&ts_active &ts_reset_active>;
		pinctrl-1 = <&ts_int_suspend &ts_reset_suspend>;

		incell_screen;
		fw_edge_limit_support;
		black_gesture_support;
		charger_pump_support;
		headset_pump_support;
		esd_handle_support;
		black_gesture_test_support;
		game_switch_support;
		noflash_support;
		lcd_trigger_load_tp_fw_support;
		smart_gesture_support;
		pressure_report_support;
		touchpanel,button-type = <4>;
		panel = <&dsi_nt36672c_tm_video>;
		resume_no_freeirq = <1>;
		support_check_bus_suspend = <1>;
	};
};
